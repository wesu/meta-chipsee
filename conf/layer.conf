## conf/layer.conf
```bitbake
# We have a conf and classes directory, add to BBPATH
BBPATH .= ":${LAYERDIR}"

# We have recipes-* directories, add to BBFILES
BBFILES += "${LAYERDIR}/recipes-*/*/*.bb ${LAYERDIR}/recipes-*/*/*.bbappend"

BBFILE_COLLECTIONS += "meta-chipsee"
BBFILE_PATTERN_meta-chipsee = "^${LAYERDIR}/"
BBFILE_PRIORITY_meta-chipsee = "7"

# This should only be incremented on significant changes that will
# cause compatibility issues with other layers
LAYERVERSION_meta-chipsee = "1"

LAYERDEPENDS_chipsee = "meta-ti"
```

## conf/machine/beaglebone.conf
```bitbake
#@TYPE: Machine
#@NAME: BeagleBone machine with Chipsee Exstension
#@DESCRIPTION: Machine configuration for the http://beagleboard.org/bone board 

require ${LAYERDIR}/../conf/machine/include/ti33x.inc

GUI_MACHINE_CLASS = "smallscreen"
MACHINE_FEATURES += "touchscreen"

IMAGE_FSTYPES += "tar.gz"

SERIAL_CONSOLE = "115200 ttyO0"

UBOOT_MACHINE = "am335x_boneblack_config"
```
